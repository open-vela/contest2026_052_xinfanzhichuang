## chips/artinchips/drv/qspi/Kconfig
```kconfig
#-----------------------------
# SPI devices local parameter
#-----------------------------

config AIC_QSPI_DRV
    bool "Enable QSPI driver v1.0"
    select SPI_DRIVER
    select SPI
    select SPI_EXCHANGE
    default n

config AIC_QSPI_DRV_V11
    bool "Enable QSPI driver v1.1"
    default n

config AIC_QSPI_DRV_V12
    bool "Enable QSPI driver v1.2"
    default n



source "../contest2026_052_xinfanzhichuang/chips/artinchips/hal/qspi/Kconfig"
```

## chips/artinchips/drv/rtc/Kconfig
```kconfig
#-----------------------------
# RTC devices local parameter
#-----------------------------

menu "RTC Parameter"
    depends on AIC_USING_RTC

config AIC_USING_IRQ
    bool "Enable RTC IRQ"
    default n
    ---help---
        Request RTC IRQ.
    if AIC_USING_IRQ
        config AIC_USING_RTC_USING_IRQn
            int "RTC IRQ number"
        default 0
    endif
    config AIC_RTC_CLK_RATE
        int "The actual rate of 32K clock"
        default 3276800

    config AIC_RTC_ALARM_IO_OUTPUT
        bool "Enable the alarm IO output"
        default n

    config AIC_RTC_32K_IO_OUTPUT
        bool "Enable the 32K clock output"
        default n

    config AIC_RTC_LOW_POWER
        bool "Enable rtc low power"
        default n
endmenu
```

## chips/artinchips/drv/sdmc/Kconfig
```kconfig
#-----------------------------
# SDMC devices local parameter
#-----------------------------

config AIC_CARD_DETECT_BY_GPIO
    bool "Using SD card detect by GPIO"
    default n
    help
      Enable SD card detect by GPIO. If not enabled, SD card detect will be done by polling.

config AUTO_MOUNT_PATH
    string "Auto mount path"
    default "/sdcard"
    help
      Auto mount path.

config AUTO_MOUNT_FSTYPE
    string "Auto mount filesystem type"
    default "fatfs"
    help
      Auto mount filesystem type (fatfs).

config AIC_USING_SDMC0
    bool "Enable SD/MMC0"
    default y
    help
      Enable SD/MMC0.

# SDMC0 parameter
menu "SDMC0 Parameter"
    depends on AIC_USING_SDMC0

    config AIC_SDMC0_DDR_MODE
        bool "Using DDR mode"
        default n

    config AIC_SDMC0_IS_SDIO
        bool "SDMC0 connect to a SDIO device"
        select AIC_SDMC_IRQ_MODE
        default n

    config AIC_SDMC0_DRV_PHASE
        int "SDMC0 driver phase"
        range 0 3
        default 3

    config AIC_SDMC0_SMP_PHASE
        int "SDMC0 sample phase"
        range 0 3
        default 0

    config AIC_SDMC0_CLK_FREQ
        int "SDMC0 CMU clock frequency"
        range 400 200000
        default 50000
endmenu

config AIC_USING_SDMC1
    bool "Enable SD/MMC1"
    default y
    help
      Enable SD/MMC1.

menu "SDMC1 Parameter"
    depends on AIC_USING_SDMC1

    config AIC_SDMC1_USING_HOTPLUG
        bool "Using SDcard hotplug detection"
        default n

    config AIC_SDMC1_HOTPLUG_PIN
        string "sdcard hotplug gpio"
        default "PC.6"
        depends on AIC_SDMC1_USING_HOTPLUG

    config AIC_SDMC1_IS_SDIO
        bool "SDMC1 connect to a SDIO device"
        select AIC_SDMC_IRQ_MODE
        default n

    config AIC_SDMC1_DRV_PHASE
        int "SDMC1 driver phase"
        range 0 3
        default 3

    config AIC_SDMC1_SMP_PHASE
        int "SDMC1 sample phase"
        range 0 3
        default 0

    config AIC_SDMC1_CLK_FREQ
        int "SDMC1 CMU clock frequency (KHz)"
        range 400 200000
        default 50000

    choice
        prompt "Select SDMC1 buswidth"
            default AIC_SDMC1_BUSWIDTH4

        config AIC_SDMC1_BUSWIDTH4
            bool "SDMC1 buswidth 4bit"

        config AIC_SDMC1_BUSWIDTH8
            bool "SDMC1 buswidth 8bit"
        endchoice

        config AIC_SDMC1_DDR_MODE
            bool "Using DDR mode"
            default n
endmenu

config AIC_USING_SDMC2
    bool "Enable SD/MMC2"
    default y
    help
      Enable SD/MMC2.

# SDMC2 parameter
menu "SDMC2 Parameter"
    depends on AIC_USING_SDMC2
    
    config AIC_SDMC2_IS_SDIO
        bool "SDMC2 connect to a SDIO device"
        select AIC_SDMC_IRQ_MODE
        default n
    config AIC_SDMC2_DRV_PHASE
        int "SDMC2 driver phase"
        range 0 3
        default 3
    config AIC_SDMC2_SMP_PHASE
        int "SDMC2 sample phase"
        range 0 3
        default 0
    config AIC_SDMC2_CLK_FREQ
        int "SDMC2 CMU clock frequency"
        range 400 200000
        default 50000
endmenu
```

## chips/artinchips/drv/sfud/Kconfig
```kconfig
config SFUD_USING_SFDP
    bool "use SFUD_USING_SFDP"
    default n

config SFUD_USING_QSPI
    bool "use SFUD_USING_QSPI"
    default n
```

## chips/artinchips/drv/spinor/Kconfig
```kconfig
#-----------------------------
# spinor driver local parameter
#-----------------------------

config AIC_USING_QSPI0
    bool "Using SPI0"
    default n

config SFUD_DEBUG_MODE
    bool "debug for flash"
    depends on DEBUG_FEATURES
    default n

config SFUD_DEBUG_INFO
    bool "debug for flash info"
    depends on SFUD_DEBUG_MODE
    default n

config SFUD_DEBUG_ERR
    bool "debug for flash error"
    depends on SFUD_DEBUG_MODE
    default n

config SFUD_DEBUG_WARN
    bool "debug for flash warn"
    depends on SFUD_DEBUG_MODE
    default n


menuconfig AIC_QSPI0_DEVICE_SPINOR
    bool "SPI0 Devices: SPINOR"
    depends on AIC_USING_QSPI0
    default n

if AIC_QSPI0_DEVICE_SPINOR
    config AIC_QSPI0_DEVICE_SPINOR_FREQ
        int "SPINOR bus frequency(Hz)"
	default 100000000

    config AIC_DEV_QSPI0_DELAY_MODE
        int "RX Data Sample Delay"
    default 2
    range 0 3

    config AIC_DEV_QSPI0_MAX_SRC_FREQ_HZ
        int "Max frequency(Hz)"
        default 100000000

    config AIC_QSPI0_BUS_WIDTH
        int
        default 1 if AIC_QSPI0_BUS_WIDTH_1
        default 4 if AIC_QSPI0_BUS_WIDTH_4

    choice
        prompt "Set SPI0 bus width"
        default AIC_QSPI0_BUS_WIDTH_4
        config AIC_QSPI0_BUS_WIDTH_1
            bool "Standard"
        config AIC_QSPI0_BUS_WIDTH_4
            bool "Quad"
    endchoice

endif

config AIC_USING_QSPI1
    bool "Using SPI1"
    default n

menuconfig AIC_QSPI1_DEVICE_SPINOR
    bool "SPI1 Devices: SPINOR"
    depends on AIC_USING_QSPI1
    default n

if AIC_QSPI1_DEVICE_SPINOR
    config AIC_QSPI1_DEVICE_SPINOR_FREQ
        int "SPINOR bus frequency(Hz)"
	default 100000000

endif

config AIC_USING_QSPI2
    bool "Using SPI2"
    default n

menuconfig AIC_QSPI2_DEVICE_SPINOR
    bool "SPI2 Devices: SPINOR"
    depends on AIC_USING_QSPI2
    default n

if AIC_QSPI2_DEVICE_SPINOR
    config AIC_QSPI2_DEVICE_SPINOR_FREQ
        int "SPINOR bus frequency(Hz)"
	default 100000000

endif

config AIC_USING_QSPI3
    bool "Using SPI3"
    default n

menuconfig AIC_QSPI3_DEVICE_SPINOR
    bool "SPI3 Devices: SPINOR"
    depends on AIC_USING_QSPI3
    default n

if AIC_QSPI3_DEVICE_SPINOR
    config AIC_QSPI3_DEVICE_SPINOR_FREQ
        int "SPINOR bus frequency(Hz)"
	default 100000000

endif

config AIC_USING_QSPI4
    bool "Using SPI4"
    default n

menuconfig AIC_QSPI4_DEVICE_SPINOR
    bool "SPI4 Devices: SPINOR"
    depends on AIC_USING_QSPI4
    default n

if AIC_QSPI4_DEVICE_SPINOR
    config AIC_QSPI4_DEVICE_SPINOR_FREQ
        int "SPINOR bus frequency(Hz)"
	default 100000000

endif

config AIC_USING_SE_SPI
    bool "Using SE_SPI"
    default n

menuconfig AIC_SE_SPI_DEVICE_SPINOR
    bool "SE_SPI Devices: SPINOR"
    depends on AIC_USING_SE_SPI
    default n

if AIC_SE_SPI_DEVICE_SPINOR
    config AIC_SE_SPI_DEVICE_SPINOR_FREQ
        int "SPINOR bus frequency(Hz)"
	default 50000000

endif
```

## chips/artinchips/drv/wdt/Kconfig.drv
```kconfig
config AIC_USING_WDT
    bool "Using WDT"
    default n
    select WATCHDOG
    select ARCH_HAVE_RESET
```

## chips/artinchips/hal/Kconfig
```kconfig
source "../contest2026_052_xinfanzhichuang/chips/artinchips/hal/cmu/Kconfig"

config  DRIVER_QSPI_HAL_EN
  bool "QSPI hal"
	default n

if DRIVER_QSPI_HAL_EN
source "../contest2026_052_xinfanzhichuang/chips/artinchips/hal/qspi/Kconfig"
endif

config DRIVER_ADCIM_HAL_EN
  bool "ADCIM hal"
	default n

if DRIVER_ADCIM_HAL_EN
source "../contest2026_052_xinfanzhichuang/chips/artinchips/hal/adcim/Kconfig"
endif

config  DRIVER_GPAI_HAL_EN
  bool "GPAI hal"
	default n
  depends on DRIVER_ADCIM_HAL_EN

if DRIVER_GPAI_HAL_EN

    config AIC_USING_GPAI0
    bool "Using GPAI0"
    default n

    config AIC_USING_GPAI1
    bool "Using GPAI1"
    default n

    config AIC_USING_GPAI2
    bool "Using GPAI2"
    default n

    config AIC_USING_GPAI3
    bool "Using GPAI3"
    default n

    config AIC_USING_GPAI4
    bool "Using GPAI4"
    default n

    config AIC_USING_GPAI5
    bool "Using GPAI5"
    default n

    config AIC_USING_GPAI6
    bool "Using GPAI6"
    default n

    config AIC_USING_GPAI7
    bool "Using GPAI7"
    default n

    config AIC_USING_GPAI8
    bool "Using GPAI8"
    default n

    config AIC_USING_GPAI9
    bool "Using GPAI9"
    default n

    config AIC_USING_GPAI10
    bool "Using GPAI10"
    default n

    config AIC_USING_GPAI11
    bool "Using GPAI11"
    default n

    config AIC_USING_GPAI12
    bool "Using GPAI12"
    default n

    config AIC_USING_GPAI13
    bool "Using GPAI13"
    default n

    config AIC_USING_GPAI14
    bool "Using GPAI14"
    default n

    config AIC_USING_GPAI15
    bool "Using GPAI15"
    default n

    config AIC_USING_GPAI16
    bool "Using GPAI16"
    default n

    config AIC_USING_GPAI17
    bool "Using GPAI17"
    default n

    config AIC_USING_GPAI18
    bool "Using GPAI18"
    default n

    config AIC_USING_GPAI19
    bool "Using GPAI19"
    default n

    config AIC_USING_GPAI20
    bool "Using GPAI20"
       default n
    
    config AIC_USING_GPAI21
    bool "Using GPAI21"
    default n
    
    config AIC_USING_GPAI22
    bool "Using GPAI22"
    default n
    
    config AIC_USING_GPAI23
    bool "Using GPAI23"
    default n
    
    config AIC_USING_GPAI24
    bool "Using GPAI24"
    default n
    
  config AIC_USING_GPAI23
    bool "Using GPAI23"
    default n
  

source "../contest2026_052_xinfanzhichuang/chips/artinchips/hal/gpai/Kconfig"
endif

config DRIVER_PSADC_HAL_EN
  bool "PSADC hal"
	default n

if DRIVER_PSADC_HAL_EN
source "../contest2026_052_xinfanzhichuang/chips/artinchips/hal/psadc/Kconfig"
endif

config  DRIVER_SDMC_HAL_EN
  bool "SDMC hal"
	default n

if DRIVER_SDMC_HAL_EN
source "../contest2026_052_xinfanzhichuang/chips/artinchips/hal/sdmc/Kconfig"
endif
```

## chips/artinchips/hal/audio/Kconfig
```kconfig
config  AIC_USING_AUDIO
  bool "aic_display hal"
  depends on AIC_USING_DMA
	default n
```

## chips/artinchips/hal/cmu/Kconfig
```kconfig
choice
    prompt "chose cmu version"
    default AIC_V1_CMU
    help
        chose cmu version
  config AIC_V1_CMU
  bool "AIC_V1_CMU"

  config AIC_V2_CMU
  bool "AIC_V2_CMU"
endchoice
```

## chips/artinchips/hal/psadc/Kconfig
```kconfig
config AIC_USING_PSADC
	bool "Using PSADC"
	default n
	depends on ARCH_CHIP_D13X

if AIC_USING_PSADC

config AIC_USING_PSADC2
	bool "Using PSADC2"
	default n

endif
```

## chips/artinchips/hal/qspi/Kconfig
```kconfig
config AIC_SUPPORT_SPI_IN_BIT_MODE
    bool "Enable SPI bit mode"
    default n

config AIC_SUPPORT_SPI_X_WIRE_IN_BIT_MODE
    int "SPI bit mode is 3-WIRE or STD"
    depends on AIC_SUPPORT_SPI_IN_BIT_MODE
    default 3
    range 3 4

choice
	prompt "QSPI version"
	default AIC_QSPI_DRV_V11

	config AIC_QSPI_DRV_V11
	bool "Use qspi v1.1"

	config AIC_QSPI_DRV_V12
	bool "Use qspi v1.2"

	config AIC_QSPI_DRV_V2X
	bool "Use qspi v2.x"

endchoice
```

## chips/artinchips/peripheral/bt/Kconfig
```kconfig
#
# Bluetooth Driver Configuration
#

menu "Bluetooth Support"

config AIC_BT_BT8858A
    bool "BT8858A Bluetooth driver"
    default n
    select SERIAL
    help
        Enable BT8858A/AIC8800 Bluetooth driver.
        This driver communicates with the BT module via UART2.
        RTS/CTS is optional and controlled by AIC_BT_UART_HW_FLOWCTRL.

if AIC_BT_BT8858A

config AIC_BT_BT8858A_VELA_HCI
    bool "Expose AIC8800 controller as Vela HCI H4 device"
    default y
    depends on AIC_WLAN_AIC8800D40L && AIC8800_BT_SUPPORT
    select DRIVERS_WIRELESS
    select DRIVERS_BLUETOOTH
    select UART_BTH4
    help
        Register the AIC8800D40L Bluetooth controller as /dev/ttyHCI0
        through the NuttX BTH4 pseudo device. This path lets openVela/Zblue
        own the Bluetooth host stack.

config BLUETOOTH_CONNECTION_MANAGER
    bool
    default y if AIC_BT_BT8858A_VELA_HCI && BLUETOOTH_GATT_SERVER && BLUETOOTH_STACK_LE_ZBLUE

config AIC_BT_BT8858A_VELA_HCI_DUMP
    bool "Dump AIC8800 HCI H4 packets"
    default n
    depends on AIC_BT_BT8858A_VELA_HCI
    help
        Print a short hexadecimal dump of HCI TX/RX packets. Enable this
        only while debugging controller bring-up.

config AIC_BT_BT8858A_VELA_HCI_POWER_CYCLE
    bool "Power-cycle BT_ON when starting AIC8800 HCI"
    default n
    depends on AIC_BT_BT8858A_VELA_HCI
    help
        Force BT_ON low/high during HCI start. Leave this disabled for the
        AIC8800 combo path because the WiFi SDIO driver downloads the BT
        patch and configures the BT UART before the HCI UART is usable.
        Power-cycling BT_ON after that can clear the loaded BT patch.

config AIC_BT_BTMODE
    int "AIC8800 BT patch mode"
    default 2
    range 0 5
    depends on AIC_WLAN_AIC8800D40L && AIC8800_BT_SUPPORT
    help
        Select the btmode value written into the AIC8800 BT patch table.

        0: BT only with switch
        1: WiFi/BT combo
        2: BT only without switch
        3: BT only test
        4: WiFi/BT combo test
        5: BT only COANT mode

        The RT-Thread reference overwrites AIC8800D80 to 2 in code, while
        the D80 U02 patch table default is 5. Keep this configurable while
        validating the BLE HCI firmware mode.

config AIC_BT_UART_PORT
    string "BT UART port device"
    default "/dev/ttyS2"
    help
        UART device path for BT communication.
        Default is UART2 (/dev/ttyS2).

config AIC_BT_UART_BAUD
    int "BT UART baud rate"
    default 1500000
    help
        Baud rate for BT UART communication.

config AIC_BT_UART_HW_FLOWCTRL
    bool "Enable BT UART RTS/CTS flow control"
    default n
    help
        Enable hardware flow control on the BT UART. Keep this disabled until
        the board RTS/CTS wiring and UART mode are verified. The AIC8800 BT
        patch table uses the same setting so the controller and host UART stay
        in sync.

config AIC_BT_UART_DUMP
    bool "Dump BT UART traffic"
    default n
    help
        Print BT UART TX/RX bytes for board bring-up. Enable this only while
        debugging the AT command channel.

endif # AIC_BT_BT8858A

endmenu
```

## chips/artinchips/peripheral/bt/bt8858a/Kconfig
```kconfig
config AIC_BT_BT8858A
    bool "Using BT8858A/8852A driver"
    default n

if AIC_BT_BT8858A

config AIC_BT_START
    bool "Auto-start BT at boot"
    default n
    ---help---
        Start the BT8858A BT driver automatically at boot.

config AIC_BT_START_PRIORITY
    int "BT start task priority"
    default 120
    depends on AIC_BT_START

config AIC_BT_START_STACKSIZE
    int "BT start task stack size"
    default 8192
    depends on AIC_BT_START

endif # AIC_BT_BT8858A

config AIC_BT_STOP
    bool "Enable btstop command"
    default y if AIC_BT_START
    ---help---
        Enable the btstop command to stop the BT stack.
```
