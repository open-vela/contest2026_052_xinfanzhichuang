## chips/artinchips/peripheral/ethernet/Kconfig
```kconfig
#
# ArtInChip GMAC Ethernet configuration
#

menu "Ethernet Support"

config AIC_USING_GMAC0
	bool "Enable GMAC0 Ethernet"
	default n
	depends on NET
	select NETDEVICES
	select NET_ETHERNET

if AIC_USING_GMAC0

config AIC_DEV_GMAC0_PHYRST_GPIO
	string "GMAC0 PHY reset GPIO"
	default "PE.6"

config AIC_DEV_GMAC0_RMII
	bool
	default y

config AIC_DEV_GMAC0_PHY_EXTCLK
	bool "PHY provides RMII 50MHz reference clock"
	default y
	help
		The D133CBS-QFN88-V1-2 board routes the PHY 50MHz RMII reference
		clock to PE3/EMAC_REFCLK.

config AIC_DEV_GMAC0_CLKOUT2_25M
	bool "Enable CLK_OUT2 25MHz for PHY crystal input"
	default y
	help
		The board routes PE10/CLK_OUT2 to the RTL8201F 25MHz clock input.

config AIC_DEV_GMAC0_PHYADDR
	int "GMAC0 PHY MDIO address"
	default 0
	range 0 31

config AIC_DEV_GMAC0_MACADDR
	string "GMAC0 MAC address"
	default "02:22:44:88:77:66"

config AIC_DEV_GMAC0_PHY_POLL_MS
	int "GMAC0 PHY poll interval in ms"
	default 1000
	range 200 10000

config AIC_DEV_GMAC0_TXDELAY
	int
	default 0

config AIC_DEV_GMAC0_RXDELAY
	int
	default 0

endif

endmenu
```

## chips/artinchips/peripheral/wireless/Kconfig
```kconfig
#
# Wireless Driver Configuration
#

menu "Wireless Support"

config AIC_WIRELESS_LAN
    bool "Enable wireless LAN support"
    default n

menuconfig AIC_WLAN_AIC8800D40L
    bool "AIC8800 WiFi driver"
    default n
    depends on AIC_WIRELESS_LAN
    help
        Enable AIC8800D40L WiFi/BT combo module driver.
        Uses SDIO interface for WiFi, UART for BT.

if AIC_WLAN_AIC8800D40L

source "../contest2026_052_xinfanzhichuang/chips/artinchips/peripheral/wireless/aic8800/Kconfig.dev"

endif # AIC_WLAN_AIC8800D40L

endmenu
```

## framework/Kconfig
```kconfig
menu "AIC framework"

source "../contest2026_052_xinfanzhichuang/framework/connectivity/Kconfig"
source "../contest2026_052_xinfanzhichuang/framework/input/Kconfig"

endmenu # AIC framework
```

## framework/connectivity/Kconfig
```kconfig
menu "Connectivity"

source "../contest2026_052_xinfanzhichuang/framework/connectivity/bt_ext/Kconfig"

endmenu # Connectivity
```

## framework/connectivity/bt_ext/Kconfig
```kconfig
config AIC_BT_EXT
	bool "AIC external Bluetooth API"
	default y if AIC_EXBT
	depends on AIC_EXBT
	help
		Provide upper-application APIs for the external ESP32S
		Bluetooth adapter over UART0.
```

## framework/input/Kconfig
```kconfig
menu "Input"

source "../contest2026_052_xinfanzhichuang/framework/input/button/Kconfig"

endmenu # Input
```

## framework/input/button/Kconfig
```kconfig
config AIC_INPUT_BUTTON
	bool "AIC board button API"
	default n
	depends on ARCH_CHIP_D13X
	depends on !AIC_USING_GPAI2
	depends on !AIC_I2C1
	depends on !AIC_BT_UART_HW_FLOWCTRL
	select DRIVER_PSADC_HAL_EN
	select AIC_USING_PSADC
	select AIC_USING_PSADC2
	help
		Provide the board button API. D133CBS direction keys are read
		from the KEYADC resistor ladder on PSADC2 in single-sample mode,
		and WAKEUP is read from the low-active KEY_WAKEUP GPIO.

if AIC_INPUT_BUTTON

config AIC_INPUT_BUTTON_PSADC_CH
	int "Direction key PSADC channel"
	default 2
	range 0 15

config AIC_INPUT_BUTTON_WAKEUP_PIN
	string "WAKEUP key GPIO"
	default "PD.15"

config AIC_INPUT_BUTTON_WAKEUP_SOURCE
	bool "Keep WAKEUP key as a wake source"
	default y
	help
		Mark the WAKEUP GPIO as a wake source in board pinmux data.
		This preserves the pin across board pinmux deinit and prepares
		the pin for later PM wake policy integration. It does not enter
		sleep by itself.

config AIC_INPUT_BUTTON_POLL_INTERVAL_MS
	int "Button poll interval in milliseconds"
	default 50
	range 10 1000

config AIC_INPUT_BUTTON_PSADC_READ_TIMEOUT_MS
	int "Button PSADC read timeout in milliseconds"
	default 200
	range 1 1000

config AIC_INPUT_BUTTON_DEBOUNCE_SAMPLES
	int "Stable samples required for debounce"
	default 2
	range 1 8

config AIC_INPUT_BUTTON_ADC_MIN
	int "Minimum valid KEYADC raw value (12-bit)"
	default 80
	range 0 4095

config AIC_INPUT_BUTTON_ADC_MAX
	int "Maximum valid KEYADC raw value (12-bit)"
	default 2300
	range 0 4095

config AIC_INPUT_BUTTON_ADC_KEY_WINDOW
	int "KEYADC match window around each key center"
	default 180
	range 1 2048

config AIC_INPUT_BUTTON_ADC_UP_CENTER
	int "UP key raw center value"
	default 960
	range 0 4095

config AIC_INPUT_BUTTON_ADC_DOWN_CENTER
	int "DOWN key raw center value"
	default 560
	range 0 4095

config AIC_INPUT_BUTTON_ADC_LEFT_CENTER
	int "LEFT key raw center value"
	default 1890
	range 0 4095

config AIC_INPUT_BUTTON_ADC_RIGHT_CENTER
	int "RIGHT key raw center value"
	default 1550
	range 0 4095

config AIC_INPUT_BUTTON_THREAD_PRIORITY
	int "Button callback thread priority"
	default 100

config AIC_INPUT_BUTTON_THREAD_STACKSIZE
	int "Button callback thread stack size"
	default 4096

config AIC_INPUT_BUTTON_AUTOSTART
	bool "Start button service automatically"
	default y
	help
		Start the button sampling service during system startup.
		The service keeps running and publishes button events to all
		registered subscribers.

config AIC_INPUT_BUTTON_EVENT_LOG
	bool "Print button events from the service"
	default y
	help
		Print each debounced pressed/released event from the button worker.
		This keeps board bring-up observable immediately after boot without
		running the temporary button listen command.

config AIC_INPUT_BUTTON_AUTOSTART_DELAY_MS
	int "Button service auto-start delay in milliseconds"
	default 2000
	range 0 10000
	depends on AIC_INPUT_BUTTON_AUTOSTART

endif
```
