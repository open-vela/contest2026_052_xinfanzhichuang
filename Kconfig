## app/lvgl_app/velaclaw/Kconfig
```kconfig
#
# Copyright (C) 2026 Xiaomi Corporation
#
# Licensed under the Apache License, Version 2.0 (the "License");
# you may not use this file except in compliance with the License.
# You may obtain a copy of the License at
#
#      http://www.apache.org/licenses/LICENSE-2.0
#
# Unless required by applicable law or agreed to in writing, software
# distributed under the License is distributed on an "AS IS" BASIS,
# WITHOUT WARRANTIES OR CONDITIONS OF ANY KIND, either express or implied.
# See the License for the specific language governing permissions and
# limitations under the License.
#

#
# For a description of the syntax of this configuration file,
# see the file kconfig-language.txt in the NuttX tools repository.
#

config EXAMPLES_VELACLAW_VELA
	tristate "VelaClaw Vela AI Agent"
	default n
	select CRYPTO_MBEDTLS
	select NETUTILS_CJSON
	select NETUTILS_MQTTC
	select SYSTEM_SYSTEM
	---help---
		Enable the VelaClaw AI Agent ported to Vela/NuttX.
		Requires network connectivity and mbedTLS.

if EXAMPLES_VELACLAW_VELA

config EXAMPLES_VELACLAW_VELA_PROGNAME
	string "Program name"
	default "velaclaw"
	---help---
		Name of the NSH built-in command.

config EXAMPLES_VELACLAW_VELA_PRIORITY
	int "Agent task priority"
	default 100

config EXAMPLES_VELACLAW_VELA_STACKSIZE
	int "Agent main stack size"
	default 32768

config EXAMPLES_VELACLAW_VELA_DATA_DIR
	string "Persistent data directory"
	default "/data/velaclaw"
	---help---
		Base directory for config, memory and session files.
		Must be on a writable filesystem (e.g. littlefs, romfs+ramdisk).

config EXAMPLES_VELACLAW_VOICE_BACKEND_MIMO
	bool "Enable MiMo ASR/TTS voice backend"
	default y
	---help---
		Use Xiaomi MiMo OpenAI-compatible audio models for ASR and TTS.

config EXAMPLES_VELACLAW_VOICE_BACKEND_VOLC
	bool "Enable Volcengine ASR/TTS voice backend"
	default y
	---help---
		Keep the original Volcengine voice backend as an optional fallback.

config EXAMPLES_VELACLAW_VOICE_ASR_DEFAULT_BACKEND
	string "Default ASR backend"
	default "mimo"
	---help---
		Name of the ASR backend selected at startup.

config EXAMPLES_VELACLAW_VOICE_TTS_DEFAULT_BACKEND
	string "Default TTS backend"
	default "mimo"
	---help---
		Name of the TTS backend selected at startup.

config EXAMPLES_VELACLAW_VELA_NODE_ID
	string "Node client ID"
	default "watch-01"
	---help---
		Unique identifier for this device when connecting to an
		OpenClaw Gateway as a Node. Used in tool names like
		node:<id>:<command>.

config EXAMPLES_VELACLAW_VELA_NODE_DISPLAY_NAME
	string "Node client display name"
	default "Smart Watch"
	---help---
		Human-readable name shown on the Hub side for this Node.

choice
	prompt "Shell security policy"
	default EXAMPLES_VELACLAW_VELA_SHELL_ALLOWLIST
	---help---
		Security policy for run_shell tool execution.
		- Allowlist: Only pre-approved commands (safest for production)
		- Full: Allow most commands except critical ones (for development/skills)
		- Deny: Disable run_shell completely

config EXAMPLES_VELACLAW_VELA_SHELL_ALLOWLIST
	bool "Allowlist mode (production)"
	---help---
		Only allow pre-approved safe commands. Blocks shell meta-characters
		(pipes, redirects, etc.) and dangerous commands (rm, reboot, etc.).
		Recommended for production deployments.

config EXAMPLES_VELACLAW_VELA_SHELL_FULL
	bool "Full mode (development)"
	---help---
		Allow most shell commands and features (pipes, redirects, etc.).
		Only blocks critical system commands (reboot, mkfs, insmod, etc.).
		Recommended for development and skill authoring.

config EXAMPLES_VELACLAW_VELA_SHELL_DENY
	bool "Deny mode (disabled)"
	---help---
		Completely disable run_shell tool. Use when shell access is not needed.

endchoice

config VELACLAW_TEST
	bool "Enable integration test commands"
	default n
	---help---
		Compile the claw_test CLI command and vision integration test
		harness. Adds ~2KB code. Use 'claw_test' in NSH to run tests.

config VELACLAW_TEST_IMAGE_DIR
	string "Test image directory"
	default "/data/velaclaw/test"
	depends on VELACLAW_TEST
	---help---
		Directory for test images used by the vision integration tests.
		Images can be pre-pushed via adb or generated at runtime.
		Must be on a writable filesystem.

endif
```

## app/testadc/Kconfig
```kconfig
#
# Copyright (c) 2024 ArtInChip Technology Co., Ltd.
#
# SPDX-License-Identifier: Apache-2.0
#

config AIC_TEST_ADC
	bool "ArtInChip ADC Test"
	depends on ADC
	default n
	---help---
		Enable the ArtInChip ADC test application
```

## app/testpwm/Kconfig
```kconfig
#
# Copyright (c) 2024 ArtInChip Technology Co., Ltd.
#
# SPDX-License-Identifier: Apache-2.0
#

config AIC_TEST_PWM
	bool "ArtInChip PWM Test"
	depends on PWM
	default n
	---help---
		Enable the ArtInChip PWM test application
```

## app/uart2_test/Kconfig
```kconfig
config AIC_UART2_TEST
    bool "UART2 raw test command"
    default y if AIC_USING_UART2
    depends on AIC_USING_UART2 && SERIAL
    help
        Provide uart2test for checking the D13x UART2 TX/RX path without
        starting the Bluetooth stack.
```

## app/wifi_cmd/Kconfig
```kconfig
config AIC_WIFI_CMD
    bool "AIC8800 WiFi test commands"
    default y if AIC_WLAN_AIC8800D40L
    depends on AIC_WLAN_AIC8800D40L
    ---help---
        Provide wifistart, wifistop, wifiscan, wificonnect,
        wifidisconnect and wifistatus commands for the local AIC8800 driver.
```

## boards/d13x_demo88-nor/Kconfig
```kconfig
config D13X_DEMO88_NSH
	bool "Enable the NSH fucntion on the 'D13X_DEMO88' board"

config D13X_DEMO88_OTA
	bool "Enable the OTA fucntion on the 'D13X_DEMO88' board"

config ARCH_BOARD_D13X_DEMO88
    select ARCH_FPU
    select ARCH_HAVE_RESET
    bool "Enable the 'D13X_DEMO88' board"

config AIC_CLK_PLL_INT0_FREQ
    int
    default 480000000
    help
      The frequency of the PLL INT0 output in Hz.

config AIC_CLK_PLL_INT1_FREQ
    int
    default 1200000000
    help
      The frequency of the PLL INT1 output in Hz.

config AIC_CLK_PLL_FRA0_FREQ
    int
    default 792000000
    help
      The frequency of the PLL FRA0 output in Hz.

config AIC_CLK_PLL_FRA2_FREQ
    int
    default 1188000000
    help
      The frequency of the PLL FRA2 output in Hz.

config AIC_CLK_CPU_FREQ
    int
    default 480000000
    help
      The frequency of the CPU output in Hz.

config AIC_CLK_AXI0_FREQ
    int
    default 200000000
    help
      The frequency of the AXI0 output in Hz.

config AIC_CLK_AHB0_FREQ
    int
    default 200000000
    help
      The frequency of the AXI1 output in Hz.

config AIC_CLK_APB0_FREQ
    int
    default 100000000
    help
      The frequency of the APB0 output in Hz.


if ARCH_BOARD_D13X_DEMO88

choice
    prompt "Target Board Selection"
    default AIC_TARGET_D13X_DEMO88_NOR
    help
      Select the target board configuration.

config AIC_TARGET_D13X_DEMO88_NOR
    bool "D13X Demo88 NOR"

endchoice

config AIC_TARGET_DIR_NAME
    string
    default "d13x_demo88-nor" if AIC_TARGET_D13X_DEMO88_NOR

config AIC_ADBD_TCP_AUTOSTART
    bool "Autostart ADB daemon over TCP"
    default n
    depends on SYSTEM_ADBD
    depends on ADBD_TCP_SERVER
    help
      Start the NuttX ADB daemon from the board startup script. This is a
      debug-only transport for boards without a usable UART console. The
      daemon listens on the configured ADB TCP port after networking is
      available.

config AIC_EXBT
    bool "ESP32S external Bluetooth UART0 mux"
    default n
    depends on AIC_USING_UART0
    select I2C
    select I2C_DRIVER
    select AIC_USING_I2C
    select AIC_I2C0
    help
      Enable board-level mode detection using one I2C0 pin. When the
      selected pin is sampled low, UART0 is released from console/debug
      use and remains available as /dev/ttyS0 for an external Bluetooth
      module.

if AIC_EXBT

choice
    prompt "External Bluetooth mode detect pin"
    default AIC_EXBT_DETECT_I2C0_SCL

config AIC_EXBT_DETECT_I2C0_SCL
    bool "I2C0 SCL (J11-1 / PD.0)"

config AIC_EXBT_DETECT_I2C0_SDA
    bool "I2C0 SDA (J11-2 / PD.1)"

endchoice

config AIC_EXBT_DETECT_PIN
    string
    default "PD.0" if AIC_EXBT_DETECT_I2C0_SCL
    default "PD.1" if AIC_EXBT_DETECT_I2C0_SDA

config AIC_EXBT_I2C0_SCL_PIN
    string
    default "PD.0"

config AIC_EXBT_I2C0_SDA_PIN
    string
    default "PD.1"

config AIC_EXBT_UART_DEV
    string "External Bluetooth UART device"
    default "/dev/ttyS0"

config AIC_EXBT_UART_BAUD
    int "External Bluetooth UART baudrate"
    default 115200

endif

endif
```

## boards/d13x_demo88-nor/pack/d13x_os.its
```
/dts-v1/;

/ {
	description = "nuttx-artinchip firmware";
	#address-cells = <1>;

	images {
		version = "1.0.0";
		seg0 {
			description = "Artinchip segment 0";
			data = /incbin/("./nuttx.bin");
			type = "firmware";
			arch = "riscv";
			os = "artinchip";
			load = <0x40000000>;
			entry = <0x40000000>;
			hash-1 {
				algo = "crc32";
			};
			hash-2 {
				algo = "md5";
			};
		};
	};

	configurations {
		default = "conf-1";
		conf-1 {
			description = "nuttx-artinchip firmware";
			firmware = "seg0";
		};
	};
};
```

## boards/d13x_rivoride_m4-nor/Kconfig
```kconfig
config D13X_RIVORIDE_M4_NSH
	bool "Enable the NSH fucntion on the 'D13X_RIVORIDE_M4' board"

config D13X_RIVORIDE_M4_OTA
	bool "Enable the OTA fucntion on the 'D13X_RIVORIDE_M4' board"

config ARCH_BOARD_D13X_RIVORIDE_M4
    select ARCH_FPU
    select ARCH_RV_ISA_M
    select ARCH_RV_ISA_A
    select ARCH_RV_ISA_C
    bool "Enable the 'D13X_RIVORIDE_M4' board"

config AIC_CLK_PLL_INT0_FREQ
    int
    default 480000000
    help
      The frequency of the PLL INT0 output in Hz.

config AIC_CLK_PLL_INT1_FREQ
    int
    default 1200000000
    help
      The frequency of the PLL INT1 output in Hz.

config AIC_CLK_PLL_FRA0_FREQ
    int
    default 792000000
    help
      The frequency of the PLL FRA0 output in Hz.

config AIC_CLK_PLL_FRA2_FREQ
    int
    default 1188000000
    help
      The frequency of the PLL FRA2 output in Hz.

config AIC_CLK_CPU_FREQ
    int
    default 480000000
    help
      The frequency of the CPU output in Hz.

config AIC_CLK_AXI0_FREQ
    int
    default 200000000
    help
      The frequency of the AXI0 output in Hz.

config AIC_CLK_AHB0_FREQ
    int
    default 200000000
    help
      The frequency of the AXI1 output in Hz.

config AIC_CLK_APB0_FREQ
    int
    default 100000000
    help
      The frequency of the APB0 output in Hz.


if ARCH_BOARD_D13X_RIVORIDE_M4

choice
    prompt "Target Board Selection"
    default AIC_TARGET_D13X_RIVORIDE_M4_NOR
    help
      Select the target board configuration.

config AIC_TARGET_D13X_RIVORIDE_M4_NOR
    bool "D13X Demo NOR"

endchoice

config AIC_TARGET_DIR_NAME
    string
    default "d13x_rivoride_m4-nor" if AIC_TARGET_D13X_RIVORIDE_M4_NOR

endif
```

## chips/artinchips/Kconfig
```kconfig
#
# For a description of the syntax of this configuration file,
# see the file kconfig-language.txt in the NuttX tools repository.
#

choice
	prompt "ArtInChip Chip Selection"
	default ARCH_CHIP_D12X

config ARCH_CHIP_D12X
	bool "D12X series"
	select ARCH_RV32
	select ARCH_RV_ISA_M
	select ARCH_RV_ISA_A
	select ARCH_RV_ISA_C
	select ARCH_HAVE_FPU
	select ARCH_FPU
    select ARCH_HAVE_RESET

config ARCH_CHIP_D13X
	bool "D13X series"
	select ARCH_RV32
	select ARCH_RV_ISA_M
	select ARCH_RV_ISA_A
	select ARCH_RV_ISA_C
	select ARCH_HAVE_FPU
	select ARCH_FPU
    select ARCH_HAVE_RESET
    select ONESHOT_COUNT if ONESHOT

endchoice

if ARCH_CHIP_D12X || ARCH_CHIP_D13X

menu "AIC Chip Configuration"

#---------------------------
# uart device global option
#---------------------------
config AIC_USING_UART0
    bool "Using Uart0"
    default n

config AIC_USING_UART1
    bool "Using Uart1"
    default n

config AIC_USING_UART2
    bool "Using Uart2"
    default n

config AIC_USING_UART3
    bool "Using Uart3"
    default n
if ARCH_CHIP_D13X
config AIC_USING_UART4
    bool "Using Uart4"
    default n

config AIC_USING_UART5
    bool "Using Uart5"
    default n

config AIC_USING_UART6
    bool "Using Uart6"
    default n

config AIC_USING_UART7
    bool "Using Uart7"
    default n
endif
menu "Display Support"
source "../vendor/artinchip/chips/artinchips/drv/display/Kconfig"
endmenu


#---------------------------
# i2c device global option
#---------------------------
config AIC_USING_SOFT_I2C
    bool "Using SOFT_I2C"
    default n
	select I2C           # 开启总线级 I2C 支持 (关键)
    select I2C_DRIVER    # 开启字符设备接口 (/dev/i2c-x)

config AIC_USING_I2C0
    bool "Using I2C0"
    default n
	select I2C           # 开启总线级 I2C 支持 (关键)
    select I2C_DRIVER    # 开启字符设备接口 (/dev/i2c-x)

config AIC_USING_I2C1
    bool "Using I2C1"
    default n
	select I2C           # 开启总线级 I2C 支持 (关键)
    select I2C_DRIVER    # 开启字符设备接口 (/dev/i2c-x)

config AIC_USING_PWM
    bool "Using PWM"
    default n
	depends on PWM           # 开启总线级 PWM 支持 (关键)

if AIC_USING_PWM
    config AIC_USING_PWM0
        bool "Using PWM0"
        default n
    config AIC_USING_PWM1
        bool "Using PWM1"
        default n
if ARCH_CHIP_D13X
    config AIC_USING_PWM2
        bool "Using PWM2"
        default n
    config AIC_USING_PWM3
        bool "Using PWM3"
        default n
endif
endif

config AIC_USING_CTP
    bool "using CTP"
    default n


if AIC_USING_CTP
    source "../vendor/artinchip/chips/artinchips/peripheral/touch/Kconfig"
endif

source "../contest2026_052_xinfanzhichuang/chips/artinchips/drv/Kconfig"
source "../vendor/artinchip/chips/artinchips/hal/Kconfig"

endmenu


endif
```
