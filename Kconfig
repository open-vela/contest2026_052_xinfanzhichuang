## app/Kconfig
```kconfig
#
# For a description of the syntax of this configuration file,
# see the file kconfig-language.txt in the NuttX tools repository.
#

menu "AIC apps"

source "../contest2026_052_xinfanzhichuang/app/event_btn_test/Kconfig"
source "../contest2026_052_xinfanzhichuang/app/lvgl_app/Kconfig"
source "../contest2026_052_xinfanzhichuang/app/uart2_test/Kconfig"
source "../contest2026_052_xinfanzhichuang/app/bt_cmd/Kconfig"
source "../contest2026_052_xinfanzhichuang/app/exbt_cmd/Kconfig"
source "../contest2026_052_xinfanzhichuang/app/button_cmd/Kconfig"
source "../contest2026_052_xinfanzhichuang/app/wifi_cmd/Kconfig"
source "../contest2026_052_xinfanzhichuang/app/dmic_cmd/Kconfig"
source "../contest2026_052_xinfanzhichuang/app/lcd_brightness/Kconfig"
source "../contest2026_052_xinfanzhichuang/app/testpwm/Kconfig"
source "../contest2026_052_xinfanzhichuang/app/testadc/Kconfig"
endmenu # AIC apps
```

## app/bt_cmd/Kconfig
```kconfig
config AIC_BT_CMD
    bool "AIC BT command wrappers"
    default y if AIC_BT_BT8858A
    depends on AIC_BT_BT8858A
    help
        Provide btstart, btstop, bthci, and btle commands for the local AIC
        Bluetooth driver.

config AIC_BT_CMD_CLASSIC_DIAG
    bool "Expose Classic BR/EDR diagnostic commands"
    default n
    depends on AIC_BT_CMD
    help
        Enable bthci commands that issue Classic BR/EDR HCI operations,
        such as inquiry and discoverable mode. Keep this disabled for
        AIC8800D40L BLE-only boards.
```

## app/button_cmd/Kconfig
```kconfig
config AIC_BUTTON_CMD
	bool "AIC button command"
	default y if AIC_INPUT_BUTTON
	depends on AIC_INPUT_BUTTON
	help
		Provide the button command for validating the D133CBS KEYADC
		direction keys and WAKEUP GPIO from NSH or ADB shell.
```

## app/dmic_cmd/Kconfig
```kconfig
config AIC_DMIC_CMD
	bool "AIC DMIC capture command"
	default y if AIC_AUDIO_DMIC
	depends on AIC_USING_AUDIO
	depends on AIC_AUDIO_DMIC
	depends on AIC_USING_DMA
	help
		Provide the dmic NSH command for validating the D133CBS
		stereo digital microphones on PD16/PD17.

config AIC_DMIC_CMD_DMA_CHANNEL
	int "AIC DMIC command DMA channel"
	default 1
	range 0 3
	depends on AIC_DMIC_CMD
	help
		Hardware DMA channel used by the dmic command. Keep this away
		from other active low-level DMA clients when debugging.
```

## app/event_btn_test/Kconfig
```kconfig
#
# Copyright (c) 2024 ArtInChip Technology Co., Ltd.
#
# SPDX-License-Identifier: Apache-2.0
#

config AIC_EVENT_BTN_TEST
	bool "ArtInChip Event Button Test"
	depends on INPUT_BUTTONS
	default n
```

## app/exbt_cmd/Kconfig
```kconfig
config AIC_EXBT_CMD
    bool "ESP32S external Bluetooth command"
    default y if AIC_BT_EXT
    depends on AIC_BT_EXT
    help
        Provide the exbt command for validating the external ESP32S
        Bluetooth adapter protocol over UART0.
```

## app/lcd_brightness/Kconfig
```kconfig
#
# Copyright (c) 2026 Rivotek
#
# SPDX-License-Identifier: Apache-2.0
#

config AIC_LCD_BRIGHTNESS
	bool "LCD brightness NSH command"
	default y if AIC_USING_PWM2
	depends on PWM
	help
		Enable the lcd_brightness NSH command for the D133CBS LVDS panel.
		The command accepts a 0..100 percent hardware duty cycle.

if AIC_LCD_BRIGHTNESS

config AIC_LCD_BRIGHTNESS_PWM_PATH
	string "LCD brightness PWM device path"
	default "/dev/pwm2"

config AIC_LCD_BRIGHTNESS_PWM_FREQUENCY
	int "LCD brightness PWM frequency"
	default 1000
	range 1 1000000
	help
		Use 1000 Hz for the D133CBS LCD_PWM signal. R20/R21/C42 form an
		RC network before the RY3730 EN/PWM input.

config AIC_LCD_BRIGHTNESS_PWM_CHANNEL
	int "LCD brightness PWM channel"
	default 1
	depends on PWM_MULTICHAN
	range 1 16

endif
```

## app/lvgl_app/Kconfig
```kconfig
#
# LVGL application Kconfig root.
#
menuconfig LVGL_APP
	bool "LVGL application shell"
	default y
	depends on GRAPHICS_LVGL
	depends on LV_USE_NUTTX
	help
		Enable the lvgl_app NuttX application entry. This shell keeps
		the application registration and LVGL/NuttX initialization while
		leaving all pages, resources, and business code empty for a new
		UI implementation.
if LVGL_APP
source "$APPSDIR/../contest2026_052_xinfanzhichuang/app/lvgl_app/app_main/Kconfig"
source "$APPSDIR/../contest2026_052_xinfanzhichuang/app/lvgl_app/ui_demo/Kconfig"
source "$APPSDIR/../contest2026_052_xinfanzhichuang/app/lvgl_app/velaclaw/Kconfig"
endif # LVGL_APP
```

## app/lvgl_app/app_main/Kconfig
```kconfig
menu "Application entry and main task"
	depends on LVGL_APP

config LVGL_APP_APP_MAIN_PRIORITY
	int "Main LVGL task priority"
	default 100
	help
		POSIX task priority used by the NuttX application entry point.
		The recommended default is 100 for an interactive GUI task.

config LVGL_APP_APP_MAIN_STACKSIZE
	int "Main LVGL task stack size"
	default 32768
	help
		Stack size in bytes for the LVGL UI task. The recommended
		default is 32768 bytes, which leaves room for LVGL object creation.

config LVGL_APP_APP_MAIN_LOOP_MIN_SLEEP_MS
	int "Minimum UI loop sleep in milliseconds"
	default 1
	help
		Lower bound for the sleep time after lv_timer_handler(). The
		recommended default is 1 ms to keep input latency low.

config LVGL_APP_APP_MAIN_LOOP_MAX_SLEEP_MS
	int "Maximum UI loop sleep in milliseconds"
	default 30
	help
		Upper bound for the sleep time after lv_timer_handler(). The
		recommended default is 30 ms to avoid long input stalls.

config LVGL_APP_APP_MAIN_AUTOSTART
	bool "Auto start lvgl_app after boot"
	default n
	help
		Automatically spawn lvgl_app during system startup using a
		constructor. The recommended default is n for predictable bring-up.

config LVGL_APP_APP_MAIN_AUTOSTART_DELAY_MS
	int "Auto start delay in milliseconds"
	default 1500
	depends on LVGL_APP_APP_MAIN_AUTOSTART
	help
		Delay before the auto-start helper spawns lvgl_app. The
		recommended default is 1500 ms to let device nodes appear.

config LVGL_APP_APP_MAIN_BOARD_INIT
	bool "Call BOARDIOC_INIT when needed"
	default y
	depends on BOARDCTL
	help
		Call boardctl(BOARDIOC_INIT) when the app is launched outside
		NSH architecture initialization. The recommended default is y.

config LVGL_APP_HAL_DISPLAY_FB_PATH
	string "LVGL framebuffer device path"
	default "/dev/fb0"
	help
		Framebuffer device used by the minimal LVGL/NuttX application
		shell. The legacy symbol name is kept so existing configs remain
		compatible after the old HAL directory is removed.

config LVGL_APP_HAL_DISPLAY_DEVICE_WAIT_MS
	int "Display device wait timeout in milliseconds"
	default 3000
	help
		Time to wait for the framebuffer device before calling the LVGL
		NuttX display initialization.

config LVGL_APP_HAL_INPUT_DEV_PATH
	string "LVGL input device path"
	default "/dev/input0"
	help
		Touch input device passed to the LVGL NuttX touchscreen driver
		when CONFIG_LV_USE_NUTTX_TOUCHSCREEN is enabled.

config LVGL_APP_BACKLIGHT_PWM_PATH
	string "Backlight PWM device path"
	default "/dev/pwm2"
	depends on PWM
	help
		PWM character device used for LCD backlight. The d13x_demo88-nor
		LVDS panel config uses /dev/pwm2. Leave this empty to disable
		app-side PWM backlight control.

config LVGL_APP_BACKLIGHT_PWM_FREQUENCY
	int "Backlight PWM frequency"
	default 1000
	depends on PWM
	help
		PWM frequency in Hz for the backlight output. The D133CBS board
		uses an RC network on LCD_PWM, so 1000 Hz is the validated default.

config LVGL_APP_BACKLIGHT_PWM_CHANNEL
	int "Backlight PWM channel"
	default 1
	depends on PWM_MULTICHAN
	help
		NuttX PWM channel number used when CONFIG_PWM_MULTICHAN is enabled.

config LVGL_APP_BACKLIGHT_DEFAULT_PERCENT
	int "Default backlight percent"
	default 72
	depends on PWM
	range 1 100
	help
		Default brightness applied when lvgl_app starts.

endmenu
```

## app/lvgl_app/ui_demo/Kconfig
```kconfig
menu "Quick Control Panel Demo"
	depends on LVGL_APP

config LVGL_APP_UI_DEMO
	bool "Enable quick control panel module"
	default y
	help
		Enable the app/lvgl_app/ui_demo quick control panel module.
		When disabled, only the LVGL application entry and display
		initialization remain, and this demo page is not created.

if LVGL_APP_UI_DEMO

config LVGL_APP_UI_DEMO_THREE_COLUMN
	bool "Enable LVGL9 three-column main screen"
	default y
	help
		Enable the fixed 1024x600 LVGL9 three-column layout:
		left 220 px, center 584 px, and right 220 px.

config LVGL_APP_UI_DEMO_LEFT_SCROLL
	bool "Enable vertical scrolling for left function buttons"
	default y
	depends on LVGL_APP_UI_DEMO_THREE_COLUMN
	help
		Allow vertical scrolling when the left-side function buttons
		exceed the visible height.

config LVGL_APP_UI_DEMO_CENTER_SCROLL
	bool "Enable vertical scrolling for the center device list"
	default y
	depends on LVGL_APP_UI_DEMO_THREE_COLUMN
	help
		Allow vertical scrolling when the center WiFi or Bluetooth
		device list exceeds the visible height.

config LVGL_APP_UI_DEMO_WIFI_BACKEND
	bool "Enable AIC8800 WiFi backend for the demo"
	default y if AIC_WLAN_AIC8800D40L
	depends on LVGL_APP_UI_DEMO_THREE_COLUMN
	depends on AIC_WLAN_AIC8800D40L
	select AIC_WIFI_CMD
	help
		Enable real WiFi start, scan, connect, and stop operations in
		the quick control panel. When this option is disabled or hidden
		because the AIC8800 driver is disabled, the panel still builds
		and shows WiFi as unavailable.

config LVGL_APP_UI_DEMO_WIFI_TASK_PRIORITY
	int "WiFi background task priority"
	default 100
	depends on LVGL_APP_UI_DEMO_THREE_COLUMN
	help
		POSIX task priority used for WiFi start, scan, connect, and
		stop commands.

config LVGL_APP_UI_DEMO_WIFI_TASK_STACKSIZE
	int "WiFi background task stack size"
	default 16384
	depends on LVGL_APP_UI_DEMO_THREE_COLUMN
	help
		Stack size for the WiFi background task. The default reserves
		16 KB for scan results, command output, and connection
		parameters.

config LVGL_APP_UI_DEMO_WIFI_SCAN_WAIT_MS
	int "WiFi scan wait time"
	default 5000
	depends on LVGL_APP_UI_DEMO_THREE_COLUMN
	help
		Wait time passed to wifiscan, in milliseconds.

config LVGL_APP_UI_DEMO_WIFI_CONNECT_TIMEOUT_MS
	int "WiFi connection timeout"
	default 15000
	depends on LVGL_APP_UI_DEMO_THREE_COLUMN
	help
		Connection timeout passed to wificonnect, in milliseconds.

config LVGL_APP_UI_DEMO_BLUETOOTH_BACKEND
	bool "Enable AIC Bluetooth backend for the demo"
	default y if AIC_BT_BT8858A && BLUETOOTH_SERVER
	depends on LVGL_APP_UI_DEMO_THREE_COLUMN
	depends on AIC_BT_BT8858A
	depends on BLUETOOTH_SERVER
	select AIC_BT_CMD
	help
		Enable real Bluetooth startup, passive GATT server, and stop
		operations in the quick control panel. The UI calls the
		existing btstart, bluetoothd, btle gattserver, and btstop
		entry points.

config LVGL_APP_UI_DEMO_BLUETOOTH_TASK_PRIORITY
	int "Bluetooth background task priority"
	default 100
	depends on LVGL_APP_UI_DEMO_THREE_COLUMN
	help
		POSIX task priority used for Bluetooth btstart, bluetoothd,
		GATT server, and btstop commands.

config LVGL_APP_UI_DEMO_BLUETOOTH_TASK_STACKSIZE
	int "Bluetooth background task stack size"
	default 16384
	depends on LVGL_APP_UI_DEMO_THREE_COLUMN
	help
		Stack size for Bluetooth background tasks.

config LVGL_APP_UI_DEMO_BLUETOOTH_DAEMON_STACKSIZE
	int "Bluetooth daemon task stack size"
	default 16384
	depends on LVGL_APP_UI_DEMO_THREE_COLUMN
	help
		Stack size used when the UI starts bluetoothd.

config LVGL_APP_UI_DEMO_BLUETOOTH_GATT_STACKSIZE
	int "Bluetooth GATT server task stack size"
	default 8192
	depends on LVGL_APP_UI_DEMO_THREE_COLUMN
	help
		Stack size used for the persistent btle gattserver task.

config LVGL_APP_UI_DEMO_BLUETOOTH_DEVICE_NAME
	string "Bluetooth GATT device name"
	default "AIC8800-Vela"
	depends on LVGL_APP_UI_DEMO_THREE_COLUMN
	help
		Device name passed to btle gattserver.

config LVGL_APP_UI_DEMO_NETINFO_TASK_PRIORITY
	int "Time and weather background task priority"
	default 100
	depends on LVGL_APP_UI_DEMO_THREE_COLUMN
	help
		POSIX task priority used to fetch network time and weather
		after WiFi connects.

config LVGL_APP_UI_DEMO_NETINFO_TASK_STACKSIZE
	int "Time and weather background task stack size"
	default 24576
	depends on LVGL_APP_UI_DEMO_THREE_COLUMN
	help
		Stack size for the time and weather task. The default reserves
		24 KB for HTTP requests and JSON parsing.

config LVGL_APP_UI_DEMO_NETINFO_HTTP_TIMEOUT_MS
	int "Time and weather HTTP timeout"
	default 8000
	depends on LVGL_APP_UI_DEMO_THREE_COLUMN
	help
		Connect, send, and receive timeout for the time and weather
		HTTP APIs, in milliseconds.

config LVGL_APP_UI_DEMO_WEATHER_CITY_NAME
	string "Weather display city name"
	default "Beijing"
	depends on LVGL_APP_UI_DEMO_THREE_COLUMN
	help
		City name shown in the weather widget. This value is also used
		as the UI fallback when an API fails or omits the city field.

config LVGL_APP_UI_DEMO_WEATHER_AMAP_CITY
	string "Amap weather city code"
	default "110101"
	depends on LVGL_APP_UI_DEMO_THREE_COLUMN
	help
		Adcode used by the Amap Web Service weather API. The default
		110101 is Dongcheng District, Beijing.

config LVGL_APP_UI_DEMO_WEATHER_AMAP_KEY
	string "Amap weather Web Service key"
	default ""
	depends on LVGL_APP_UI_DEMO_THREE_COLUMN
	help
		Amap Web Service key. Leave empty to let the demo use the
		no-key fallback weather API.

config LVGL_APP_UI_DEMO_WEATHER_FALLBACK_CITY_ID
	string "No-key fallback weather city code"
	default "101010100"
	depends on LVGL_APP_UI_DEMO_THREE_COLUMN
	help
		City code used by the t.weather.itboy.net fallback weather API.
		The default 101010100 is Beijing.

config LVGL_APP_UI_DEMO_MOCK_WIRELESS_DATA
	bool "Enable static wireless placeholder data"
	default y
	depends on LVGL_APP_UI_DEMO_THREE_COLUMN
	help
		Keep static placeholder data for wireless devices. The WiFi
		page uses real command scanning when the backend is enabled;
		the Bluetooth page uses real command scanning when its backend
		is enabled. This option continues to provide placeholder data
		for features that are not wired to real services yet.

config LVGL_APP_UI_DEMO_VERTICAL_SLIDERS
	bool "Enable vertical brightness and volume sliders"
	default y
	depends on LVGL_APP_UI_DEMO_THREE_COLUMN
	help
		Enable the brightness and volume sliders in the right column.
		The sliders update UI values; touch events do not reconfigure
		low-level backlight or audio drivers directly.

config LVGL_APP_UI_DEMO_STATUS_WIDGETS
	bool "Enable time, temperature, and humidity widgets"
	default y
	depends on LVGL_APP_UI_DEMO_THREE_COLUMN
	help
		Enable the time, temperature, and humidity widgets in the right
		column, and keep the external data refresh interface.

endif # LVGL_APP_UI_DEMO

endmenu
```
